## components/system_services/Kconfig.projbuild
```kconfig
menu "Amity release verification"
config AMITY_PRODUCTION_UPDATES
    bool "Require provisioned production firmware verification"
    default n
    help
        Requires the approved native secure-boot, release-mode flash encryption,
        NVS encryption and provisioned publisher verification root.
        This build option never programs eFuses or changes a running profile.
config AMITY_RELEASE_PUBLIC_KEY_DER_HEX
    string "Trusted release P-256 SPKI DER (lowercase hexadecimal)"
    default ""
    help
        The SHA-256 of these public bytes is the manifest signing_key_id.
        Empty means no signed publisher is provisioned. Production fails closed.
endmenu
```

## main/Kconfig.projbuild
```kconfig
# Development mappings are compiled independently of portable system configuration.
menu "Amity board profile"

choice AMITY_BOARD_PROFILE
    prompt "CEC carrier profile"
    default AMITY_BOARD_LEGACY_1T

config AMITY_BOARD_LEGACY_1T
    bool "Existing Amity board2 (one HDMI adapter, GPIO1/GPIO2)"

config AMITY_BOARD_DEVELOPMENT_4T
    bool "Development carrier (up to four optional HDMI adapters)"
    help
        Experimental GPIO mapping for a custom isolated-CEC carrier. Every
        connector retains its index 0..3. Defaults use the standard XIAO
        ESP32-S3 edge headers: front/back GPIO pairs 1/2, 5/6, 7/8 and 9/44.
        GPIO4 remains available for the setup/reset button;
        GPIO3 (strapping) and GPIO43 (ROM UART
        transmit) are not used. Override GPIO assignments to match the carrier.
        Set both GPIOs to -1 to disable a connector. No cable or module
        presence is inferred from CEC silence.
        This selection does not qualify electrical loading or eight-line timing.
endchoice

if AMITY_BOARD_DEVELOPMENT_4T
config AMITY_BOARD_RESET_GPIO
    int "Optional active-low setup/reset button GPIO (-1 disables)"
    range -1 48
    default -1

menu "HDMI adapter 1 (stable connector 0)"
config AMITY_TENTACLE0_FRONT_GPIO
    int "Front isolated CEC GPIO (-1 disables connector)"
    range -1 48
    default 1
config AMITY_TENTACLE0_BACK_GPIO
    int "Back isolated CEC GPIO (-1 disables connector)"
    range -1 48
    default 2
config AMITY_TENTACLE0_PRESENCE_GPIO
    int "Optional module presence input GPIO (-1 means unknown)"
    range -1 48
    default -1
config AMITY_TENTACLE0_PRESENT_HIGH
    bool "Presence input is high when the module is attached"
    default y
config AMITY_TENTACLE0_PRESENCE_PULLUP
    bool "Enable presence input pull-up (only if required by wiring)"
    default n
config AMITY_TENTACLE0_PRESENCE_PULLDOWN
    bool "Enable presence input pull-down (only if required by wiring)"
    depends on !AMITY_TENTACLE0_PRESENCE_PULLUP
    default n
endmenu

menu "HDMI adapter 2 (stable connector 1)"
config AMITY_TENTACLE1_FRONT_GPIO
    int "Front isolated CEC GPIO (-1 disables connector)"
    range -1 48
    default 5
config AMITY_TENTACLE1_BACK_GPIO
    int "Back isolated CEC GPIO (-1 disables connector)"
    range -1 48
    default 6
config AMITY_TENTACLE1_PRESENCE_GPIO
    int "Optional module presence input GPIO (-1 means unknown)"
    range -1 48
    default -1
config AMITY_TENTACLE1_PRESENT_HIGH
    bool "Presence input is high when the module is attached"
    default y
config AMITY_TENTACLE1_PRESENCE_PULLUP
    bool "Enable presence input pull-up (only if required by wiring)"
    default n
config AMITY_TENTACLE1_PRESENCE_PULLDOWN
    bool "Enable presence input pull-down (only if required by wiring)"
    depends on !AMITY_TENTACLE1_PRESENCE_PULLUP
    default n
endmenu

menu "HDMI adapter 3 (stable connector 2)"
config AMITY_TENTACLE2_FRONT_GPIO
    int "Front isolated CEC GPIO (-1 disables connector)"
    range -1 48
    default 7
config AMITY_TENTACLE2_BACK_GPIO
    int "Back isolated CEC GPIO (-1 disables connector)"
    range -1 48
    default 8
config AMITY_TENTACLE2_PRESENCE_GPIO
    int "Optional module presence input GPIO (-1 means unknown)"
    range -1 48
    default -1
config AMITY_TENTACLE2_PRESENT_HIGH
    bool "Presence input is high when the module is attached"
    default y
config AMITY_TENTACLE2_PRESENCE_PULLUP
    bool "Enable presence input pull-up (only if required by wiring)"
    default n
config AMITY_TENTACLE2_PRESENCE_PULLDOWN
    bool "Enable presence input pull-down (only if required by wiring)"
    depends on !AMITY_TENTACLE2_PRESENCE_PULLUP
    default n
endmenu

menu "HDMI adapter 4 (stable connector 3)"
config AMITY_TENTACLE3_FRONT_GPIO
    int "Front isolated CEC GPIO (-1 disables connector)"
    range -1 48
    default 9
config AMITY_TENTACLE3_BACK_GPIO
    int "Back isolated CEC GPIO (-1 disables connector)"
    range -1 48
    default 44
config AMITY_TENTACLE3_PRESENCE_GPIO
    int "Optional module presence input GPIO (-1 means unknown)"
    range -1 48
    default -1
config AMITY_TENTACLE3_PRESENT_HIGH
    bool "Presence input is high when the module is attached"
    default y
config AMITY_TENTACLE3_PRESENCE_PULLUP
    bool "Enable presence input pull-up (only if required by wiring)"
    default n
config AMITY_TENTACLE3_PRESENCE_PULLDOWN
    bool "Enable presence input pull-down (only if required by wiring)"
    depends on !AMITY_TENTACLE3_PRESENCE_PULLUP
    default n
endmenu

endif
endmenu

menu "Amity admission"

config AMITY_ADMISSION_REQUIRE_SETUP_CODE
    bool "Require the printed setup code when adding Amity"
    default n
    help
        By default, an unclaimed device is added through a physically opened
        setup window using ephemeral key exchange and encrypted messages.

        Enable this option to require the candidate's existing printed Matter
        manual setup code or QR code through a password-authenticated exchange.
        The original controller and candidate must use the same setting;
        mismatched profiles are rejected without falling back to another mode.

        This authenticates only Amity admission. It does not commission Matter,
        create a Matter fabric, or change the device's controller/member role.
        No separate Add to Amity secret is provisioned or stored.

endmenu
```

## sdkconfig.defaults
```kconfig
CONFIG_ESPTOOLPY_FLASHSIZE_8MB=y

#enable BT
CONFIG_BT_ENABLED=y
CONFIG_BT_NIMBLE_ENABLED=y

#disable BT connection reattempt
CONFIG_BT_NIMBLE_ENABLE_CONN_REATTEMPT=n

#enable lwip ipv6 autoconfig
CONFIG_LWIP_IPV6_AUTOCONFIG=y

# Use a custom partition table
CONFIG_PARTITION_TABLE_CUSTOM=y
CONFIG_PARTITION_TABLE_FILENAME="partitions.csv"
CONFIG_PARTITION_TABLE_OFFSET=0xC000

# Enable chip shell
CONFIG_ENABLE_CHIP_SHELL=n


#enable lwIP route hooks
CONFIG_LWIP_HOOK_IP6_ROUTE_DEFAULT=y
CONFIG_LWIP_HOOK_ND6_GET_GW_DEFAULT=y

# Root, video player, speaker, remote battery, and compatibility power endpoints
CONFIG_ESP_MATTER_MAX_DYNAMIC_ENDPOINT_COUNT=5

# GPIO5 is unused on current devices; its pull-up keeps FW_RESET inactive.
CONFIG_AMITY_FW_RESET_BUTTON=y

# disable softap by default
CONFIG_ESP_WIFI_SOFTAP_SUPPORT=n

# Enable OTA Requestor
CONFIG_ENABLE_OTA_REQUESTOR=y

# Enable HKDF in mbedtls

# Increase LwIP IPv6 address number to 6 (MAX_FABRIC + 1)
# unique local addresses for fabrics(MAX_FABRIC), a link local address(1)
CONFIG_LWIP_IPV6_NUM_ADDRESSES=6

# Exclude unused clusters to optimize flash and memory usage
CONFIG_SUPPORT_ACCOUNT_LOGIN_CLUSTER=n
CONFIG_SUPPORT_ACTIONS_CLUSTER=n
CONFIG_SUPPORT_ACTIVATED_CARBON_FILTER_MONITORING_CLUSTER=n
CONFIG_SUPPORT_AIR_QUALITY_CLUSTER=n
CONFIG_SUPPORT_APPLICATION_BASIC_CLUSTER=n
CONFIG_SUPPORT_APPLICATION_LAUNCHER_CLUSTER=n
CONFIG_SUPPORT_AUDIO_OUTPUT_CLUSTER=n
CONFIG_SUPPORT_BOOLEAN_STATE_CLUSTER=n
CONFIG_SUPPORT_BOOLEAN_STATE_CONFIGURATION_CLUSTER=n
CONFIG_SUPPORT_BRIDGED_DEVICE_BASIC_INFORMATION_CLUSTER=n
CONFIG_SUPPORT_CAMERA_AV_SETTINGS_USER_LEVEL_MANAGEMENT_CLUSTER=n
CONFIG_SUPPORT_CARBON_DIOXIDE_CONCENTRATION_MEASUREMENT_CLUSTER=n
CONFIG_SUPPORT_CARBON_MONOXIDE_CONCENTRATION_MEASUREMENT_CLUSTER=n
CONFIG_SUPPORT_CHANNEL_CLUSTER=n
CONFIG_SUPPORT_CHIME_CLUSTER=n
CONFIG_SUPPORT_CLOSURE_CONTROL_CLUSTER=n
CONFIG_SUPPORT_CLOSURE_DIMENSION_CLUSTER=n
CONFIG_SUPPORT_COMMISSIONER_CONTROL_CLUSTER=n
CONFIG_SUPPORT_COMMODITY_METERING_CLUSTER=n
CONFIG_SUPPORT_COMMODITY_PRICE_CLUSTER=n
CONFIG_SUPPORT_COMMODITY_TARIFF_CLUSTER=n
CONFIG_SUPPORT_CONTENT_LAUNCHER_CLUSTER=n
CONFIG_SUPPORT_CONTENT_CONTROL_CLUSTER=n
CONFIG_SUPPORT_CONTENT_APP_OBSERVER_CLUSTER=n
CONFIG_SUPPORT_DEVICE_ENERGY_MANAGEMENT_CLUSTER=n
CONFIG_SUPPORT_DEVICE_ENERGY_MANAGEMENT_MODE_CLUSTER=n
CONFIG_SUPPORT_DIAGNOSTIC_LOGS_CLUSTER=y
CONFIG_CHIP_ENABLE_BDX_LOG_TRANSFER=y
CONFIG_SUPPORT_DISHWASHER_ALARM_CLUSTER=n
CONFIG_SUPPORT_DISHWASHER_MODE_CLUSTER=n
CONFIG_SUPPORT_ELECTRICAL_GRID_CONDITIONS_CLUSTER=n
CONFIG_SUPPORT_HUMIDISTAT_CLUSTER=n
CONFIG_SUPPORT_METER_IDENTIFICATION_CLUSTER=n
CONFIG_SUPPORT_MICROWAVE_OVEN_MODE_CLUSTER=n
CONFIG_SUPPORT_DOOR_LOCK_CLUSTER=n
CONFIG_SUPPORT_ECOSYSTEM_INFORMATION_CLUSTER=n
CONFIG_SUPPORT_ELECTRICAL_ENERGY_MEASUREMENT_CLUSTER=n
CONFIG_SUPPORT_ELECTRICAL_POWER_MEASUREMENT_CLUSTER=n
CONFIG_SUPPORT_ENERGY_EVSE_CLUSTER=n
CONFIG_SUPPORT_ENERGY_EVSE_MODE_CLUSTER=n
CONFIG_SUPPORT_ETHERNET_NETWORK_DIAGNOSTICS_CLUSTER=n
CONFIG_SUPPORT_ENERGY_PREFERENCE_CLUSTER=n
CONFIG_SUPPORT_FAN_CONTROL_CLUSTER=n
CONFIG_SUPPORT_FAULT_INJECTION_CLUSTER=n
CONFIG_SUPPORT_FIXED_LABEL_CLUSTER=n
CONFIG_SUPPORT_FLOW_MEASUREMENT_CLUSTER=n
CONFIG_SUPPORT_FORMALDEHYDE_CONCENTRATION_MEASUREMENT_CLUSTER=n
CONFIG_SUPPORT_HEPA_FILTER_MONITORING_CLUSTER=n
CONFIG_SUPPORT_ICD_MANAGEMENT_CLUSTER=n
CONFIG_SUPPORT_ILLUMINANCE_MEASUREMENT_CLUSTER=n
CONFIG_SUPPORT_JOINT_FABRIC_DATASTORE_CLUSTER=n
CONFIG_SUPPORT_JOINT_FABRIC_ADMINISTRATOR_CLUSTER=n
CONFIG_SUPPORT_KEYPAD_INPUT_CLUSTER=y
CONFIG_SUPPORT_LAUNDRY_WASHER_MODE_CLUSTER=n
CONFIG_SUPPORT_LOCALIZATION_CONFIGURATION_CLUSTER=n
CONFIG_SUPPORT_LOW_POWER_CLUSTER=n
CONFIG_SUPPORT_MEDIA_INPUT_CLUSTER=y
CONFIG_SUPPORT_MEDIA_PLAYBACK_CLUSTER=y
CONFIG_SUPPORT_MICROWAVE_OVEN_CONTROL_CLUSTER=n
CONFIG_SUPPORT_MESSAGES_CLUSTER=n
CONFIG_SUPPORT_MODE_SELECT_CLUSTER=n
CONFIG_SUPPORT_NETWORK_IDENTITY_MANAGEMENT_CLUSTER=n
CONFIG_SUPPORT_NITROGEN_DIOXIDE_CONCENTRATION_MEASUREMENT_CLUSTER=n
CONFIG_SUPPORT_PROXIMITY_RANGING_CLUSTER=n
CONFIG_SUPPORT_PUSH_AV_STREAM_TRANSPORT_CLUSTER=n
CONFIG_SUPPORT_SAMPLE_MEI_CLUSTER=n
CONFIG_SUPPORT_OCCUPANCY_SENSING_CLUSTER=n
CONFIG_SUPPORT_POWER_TOPOLOGY_CLUSTER=n
CONFIG_SUPPORT_OPERATIONAL_STATE_CLUSTER=n
CONFIG_SUPPORT_OPERATIONAL_STATE_OVEN_CLUSTER=n
CONFIG_SUPPORT_OPERATIONAL_STATE_RVC_CLUSTER=n
CONFIG_SUPPORT_OVEN_MODE_CLUSTER=n
CONFIG_SUPPORT_OZONE_CONCENTRATION_MEASUREMENT_CLUSTER=n
CONFIG_SUPPORT_PM10_CONCENTRATION_MEASUREMENT_CLUSTER=n
CONFIG_SUPPORT_PM1_CONCENTRATION_MEASUREMENT_CLUSTER=n
CONFIG_SUPPORT_PM2_5_CONCENTRATION_MEASUREMENT_CLUSTER=n
CONFIG_SUPPORT_POWER_SOURCE_CLUSTER=y
CONFIG_SUPPORT_POWER_SOURCE_CONFIGURATION_CLUSTER=n
CONFIG_SUPPORT_PRESSURE_MEASUREMENT_CLUSTER=n
CONFIG_SUPPORT_PUMP_CONFIGURATION_AND_CONTROL_CLUSTER=n
CONFIG_SUPPORT_RADON_CONCENTRATION_MEASUREMENT_CLUSTER=n
CONFIG_SUPPORT_REFRIGERATOR_ALARM_CLUSTER=n
CONFIG_SUPPORT_REFRIGERATOR_AND_TEMPERATURE_CONTROLLED_CABINET_MODE_CLUSTER=n
CONFIG_SUPPORT_RELATIVE_HUMIDITY_MEASUREMENT_CLUSTER=n
CONFIG_SUPPORT_RVC_CLEAN_MODE_CLUSTER=n
CONFIG_SUPPORT_RVC_RUN_MODE_CLUSTER=n
CONFIG_SUPPORT_SERVICE_AREA_CLUSTER=n
CONFIG_SUPPORT_SMOKE_CO_ALARM_CLUSTER=n
CONFIG_SUPPORT_SOFTWARE_DIAGNOSTICS_CLUSTER=n
CONFIG_SUPPORT_SOIL_MEASUREMENT_CLUSTER=n
CONFIG_SUPPORT_SWITCH_CLUSTER=n
CONFIG_SUPPORT_TARGET_NAVIGATOR_CLUSTER=n
CONFIG_SUPPORT_TEMPERATURE_CONTROL_CLUSTER=n
CONFIG_SUPPORT_TEMPERATURE_MEASUREMENT_CLUSTER=n
CONFIG_SUPPORT_THERMOSTAT_CLUSTER=n
CONFIG_SUPPORT_THERMOSTAT_USER_INTERFACE_CONFIGURATION_CLUSTER=n
CONFIG_SUPPORT_TIME_FORMAT_LOCALIZATION_CLUSTER=n
CONFIG_SUPPORT_TIME_SYNCHRONIZATION_CLUSTER=n
CONFIG_SUPPORT_TIMER_CLUSTER=n
CONFIG_SUPPORT_TLS_CERTIFICATE_MANAGEMENT_CLUSTER=n
CONFIG_SUPPORT_TLS_CLIENT_MANAGEMENT_CLUSTER=n
CONFIG_SUPPORT_TVOC_CONCENTRATION_MEASUREMENT_CLUSTER=n
CONFIG_SUPPORT_UNIT_LOCALIZATION_CLUSTER=n
CONFIG_SUPPORT_UNIT_TESTING_CLUSTER=n
CONFIG_SUPPORT_USER_LABEL_CLUSTER=n
CONFIG_SUPPORT_VALVE_CONFIGURATION_AND_CONTROL_CLUSTER=n
CONFIG_SUPPORT_WAKE_ON_LAN_CLUSTER=n
CONFIG_SUPPORT_LAUNDRY_WASHER_CONTROLS_CLUSTER=n
CONFIG_SUPPORT_LAUNDRY_DRYER_CONTROLS_CLUSTER=n
CONFIG_SUPPORT_WEB_RTC_TRANSPORT_PROVIDER_CLUSTER=n
CONFIG_SUPPORT_WEB_RTC_TRANSPORT_REQUESTOR_CLUSTER=n
CONFIG_SUPPORT_WIFI_NETWORK_MANAGEMENT_CLUSTER=n
CONFIG_SUPPORT_WINDOW_COVERING_CLUSTER=n
CONFIG_SUPPORT_WATER_HEATER_MANAGEMENT_CLUSTER=n
CONFIG_SUPPORT_WATER_HEATER_MODE_CLUSTER=n
CONFIG_SUPPORT_ZONE_MANAGEMENT_CLUSTER=n

# Exclude newly added clusters (Matter 1.5/1.6) that are not used by the light device type
CONFIG_SUPPORT_AMBIENT_CONTEXT_SENSING_CLUSTER=n
CONFIG_SUPPORT_CAMERA_AV_STREAM_MANAGEMENT_CLUSTER=n
CONFIG_SUPPORT_MEDIA_FILE_MANAGEMENT_CLUSTER=n

# TC_RR_1_1 requires MaxGroupKeysPerFabric >= 4 (chip esp32 Kconfig defaults to 3)
CONFIG_MAX_GROUP_KEYS_PER_FABRIC=4

CONFIG_IDF_TARGET="esp32s3"
CONFIG_ESP_CONSOLE_USB_SERIAL_JTAG=y
CONFIG_ESP_MATTER_ENABLE_GENERATED_DATA_MODEL=y
CONFIG_USE_BLE_ONLY_FOR_COMMISSIONING=n
# Matter and HTTPS must share Espressif's mDNS responder and UDP 5353 socket.
CONFIG_USE_MINIMAL_MDNS=n
CONFIG_BT_NIMBLE_ROLE_CENTRAL=y
CONFIG_BT_NIMBLE_ROLE_OBSERVER=y
CONFIG_BT_NIMBLE_GATT_CLIENT=y
CONFIG_BT_NIMBLE_HID_SERVICE=y
CONFIG_BT_NIMBLE_NVS_PERSIST=y
CONFIG_BT_NIMBLE_MAX_CONNECTIONS=3
CONFIG_BT_NIMBLE_MAX_BONDS=4
CONFIG_BOOTLOADER_APP_ROLLBACK_ENABLE=y
CONFIG_ESP_MAIN_TASK_STACK_SIZE=12288
CONFIG_HTTPD_MAX_REQ_HDR_LEN=1024
CONFIG_HTTPD_MAX_URI_LEN=256
CONFIG_MBEDTLS_X509_CRT_WRITE_C=y
CONFIG_MBEDTLS_PEM_WRITE_C=y
CONFIG_MBEDTLS_PK_WRITE_C=y
CONFIG_ESP_HTTPS_SERVER_ENABLE=y
CONFIG_COMPILER_OPTIMIZATION_SIZE=y
CONFIG_SPIRAM=y
CONFIG_SPIRAM_MODE_OCT=y
CONFIG_SPIRAM_SPEED_80M=y
CONFIG_SPIRAM_USE_MALLOC=y
CONFIG_SPIRAM_MALLOC_RESERVE_INTERNAL=65536
# Keep internal DMA memory available during simultaneous CASE and TLS traffic.
CONFIG_SPIRAM_MALLOC_ALWAYSINTERNAL=1024
CONFIG_ESP_MATTER_MEM_ALLOC_MODE_EXTERNAL=y
# Matter, WiFi and BLE retain scarce internal RAM; TLS buffers use required PSRAM.
CONFIG_MBEDTLS_INTERNAL_MEM_ALLOC=n
CONFIG_MBEDTLS_EXTERNAL_MEM_ALLOC=y
CONFIG_CUSTOM_COMMISSIONABLE_DATA_PROVIDER=y
CONFIG_GPTIMER_ISR_CACHE_SAFE=y
CONFIG_GPTIMER_CTRL_FUNC_IN_IRAM=y
CONFIG_MBEDTLS_X509_CREATE_C=y

CONFIG_LWIP_MAX_SOCKETS=16
# Prefer the strongest AP when a network has multiple radios/access points.
CONFIG_WIFI_SCAN_ALL_CHANNEL_MODE=y
# Leave airtime for Bluetooth while an access point is unavailable.
CONFIG_WIFI_STATION_RECONNECT_INTERVAL=5000

# Matter Basic Information branding.
CONFIG_CHIP_PROJECT_CONFIG="CHIPProjectConfig.h"

# Keep the log ring in PSRAM to leave room for native HomeKit task stacks.
CONFIG_SPIRAM_ALLOW_BSS_SEG_EXTERNAL_MEMORY=y
# HomeKit shares the Matter-provisioned station and the existing mDNS responder.
CONFIG_HAP_HTTP_SERVER_PORT=51826
CONFIG_HAP_HTTP_CONTROL_PORT=32859
CONFIG_HAP_HTTP_MAX_OPEN_SOCKETS=4
CONFIG_HAP_HTTP_STACK_SIZE=12288
CONFIG_HAP_PLATFORM_DEF_NVS_FACTORY_PARTITION="nvs"
CONFIG_HAP_MFI_ENABLE=n
```

## tests/cec_probe/sdkconfig.defaults
```kconfig
CONFIG_IDF_TARGET="esp32s3"
CONFIG_ESPTOOLPY_FLASHSIZE_8MB=y
CONFIG_ESP_CONSOLE_USB_SERIAL_JTAG=y
CONFIG_GPTIMER_ISR_CACHE_SAFE=y
CONFIG_GPTIMER_CTRL_FUNC_IN_IRAM=y
CONFIG_ESP_MAIN_TASK_STACK_SIZE=8192
CONFIG_COMPILER_OPTIMIZATION_SIZE=y
CONFIG_PARTITION_TABLE_CUSTOM=y
CONFIG_PARTITION_TABLE_FILENAME="../../partitions.csv"
CONFIG_PARTITION_TABLE_CUSTOM_FILENAME="../../partitions.csv"
CONFIG_PARTITION_TABLE_OFFSET=0xC000
```
